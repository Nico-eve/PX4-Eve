## src/examples/smr_test/Kconfig
```kconfig
menuconfig EXAMPLES_SMR_TEST
	bool "request_mission_uorbmsg"
	default n
	---help---
		Enable support for request_mission_uorbmsg
```

## src/modules/eve_navigator/Kconfig
```kconfig
menuconfig MODULES_EVE_NAVIGATOR
	bool "eve_navigator"
	default n

menuconfig USER_NAVIGATOR
	bool "eve_navigator running as userspace module"
	default y
	depends on BOARD_PROTECTED && MODULES_NAVIGATOR
	---help---
		Put navigator in userspace memory
```
